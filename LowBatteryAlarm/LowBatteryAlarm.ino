/*
 * Система зарядки и предупреждения о низком уровне заряда на Ардуино.
 * Разработчик: RootTool
 * Мой канал в YouTube:
 * https://www.youtube.com/channel/UCHLiHHh8zDTuPTZ3gUbYr1Q
 * 
 * Видео:
 * https://www.youtube.com/
 */

#define speakerPin 11 //Пин подключения зумера(динамика).
#define batteryPin A0 //Пин подключени положительного контакта аккумулятора.

float minVoltage = 3.6; //Минимальное напряжение, после которого ардуина будет пищать.
float coeff = 1.042; //Коэффициент между напряжением аккумулятора и реальным напряжением
//1) Проверяем, чтобы DEBUG был равнен 1 и загружаем прошивку в Ардуино
//2) Измеряем напряжение на аккумуляторе
//3) Открываем монитор порта (кнопка с лупой в верхнем правом углу программы) и внизу справа ставим скорость 9600 бод.
//4) Смотрим напряжение в мониторе порта Ардуины
//5) Делим реальное напряжение на напряжение с монитора порта
//6) Вписываем полученное число в переменную coeff (Достаточно 3-4 знака после запятой)
//7) Проверяем, что напряжение в мониторе порта Ардуины сходится с истинным напряжением на аккумуляторе.
//8) Если все в норме, то ставим DEBUG на 0, чтобы Ардуина не выводила информацию просто так и не тратила время.
//Если напряжение в порту сильно отличается, то возможно надо дописать пару цифр после запятой в перемнной coeff

int del = 200; //Задержки между писками при низком уровне заряда (Мс)
int freq = 4000; //Частота пищания динамика при низком уровне заряда (Гц)
#define DEBUG 1 //Выводить напряжение аккумулятора в порт? 1-да, 0-нет
//Порт работает на скорости 9600 бод.
void setup(){
  if(DEBUG == 1){ //Если можно выводить данные
    Serial.begin(9600); //Открываем порт на скорости 9600 бод
    Serial.println("Starting"); //Пишем старт
  }
  //Делаем маленький писк, говорящий, что Ардуи на готова к работе.
  tone(speakerPin, 500);
  delay(200);
  noTone(speakerPin);
}
bool isLow = false; //Переменная, которая ставиться в true, когда аккумулятор разряжен
void loop(){
  float vol = (float)(analogRead(batteryPin) * 5.0) / 1024 * coeff; //Вычисляем напряжение на аккумуляторе
  if(DEBUG == 1) Serial.println(vol); //Если можно, то пишем значение в порт
  if(vol <= minVoltage) isLow = true; //Если аккумулятор разряжен, ставим переменную isLow в true
  
  while(isLow){ //Когда переменная isLow станет true, то запуститься бесконечный цикл, в котором Ардуина начнет пищать.
    if(DEBUG == 1){ //Если разрешено, то пишем в порт напряжение аккумулятора
      float vol = (float)(analogRead(batteryPin) * 5.0) / 1024 * coeff;
      Serial.print(vol);
      Serial.println(" - Low Voltage Battery!");
    }
    //Пищим
    tone(speakerPin, freq);
    delay(del);
    noTone(speakerPin);
    delay(del);
  }
}
